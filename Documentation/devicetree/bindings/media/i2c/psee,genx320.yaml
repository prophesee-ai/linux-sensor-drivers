## Documentation/devicetree/bindings/media/i2c/psee,genx320.yaml
```yaml
# SPDX-License-Identifier: (GPL-2.0-only OR BSD-2-Clause)
# Copyright (C) 2024 Prophesee
%YAML 1.2
---
$id: http://devicetree.org/schemas/media/i2c/spsee,genx320.yaml#
$schema: http://devicetree.org/meta-schemas/core.yaml#

title: Prophesee GenX320 Sensor

maintainers:
  - Ayman Khamouma <akhamouma@prophesee.ai>

description:
  The GenX320 is a 1/5” Format 320 x 320 pixels event-based
  vision sensor with Embedded Processing.
  It is programmable through I2C interface.
  Image data is sent through MIPI CSI-2.

properties:
  compatible:
    enum:
      - psee,genx320
  reg:
    description: I2C address
    maxItems: 1

  assigned-clocks: true
  assigned-clock-parents: true
  assigned-clock-rates: true

  clocks:
    description: Input clock
    maxItems: 1

  vadd-supply:
    description: Supply voltage (Analog)

  vddd1-supply:
    description: Supply voltage (Digital 1)

  vddd2-supply:
    description: Supply voltage (Digital 2)

  nreset-gpio:
    description: Reference to the GPIO connected to the RSTn pin, if any.
    maxItems: 1

  port:
    description: MIPI CSI-2 transmitter port
    $ref: /schemas/graph.yaml#/$defs/port-base
    additionalProperties: false

    properties:
      endpoint:
        $ref: /schemas/media/video-interfaces.yaml#
        unevaluatedProperties: false

        properties:
          data-lanes:
            minItems: 1
            maxItems: 1

        required:
          - data-lanes

required:
  - compatible
  - reg
  - clocks
  - port

additionalProperties: false

examples:
  - |
    i2c0 {
        #address-cells = <1>;
        #size-cells = <0>;

        camera@3c {
            compatible = "psee,genx320";
            reg = <0x3c>;
            clocks = <&genx320_clk>;

            assigned-clocks = <&genx320_clk>;
            assigned-clock-parents = <&genx320_clk_parent>;
            assigned-clock-rates = <20000000>;

            port {
                genx320: endpoint {
                    remote-endpoint = <&csirx>;
                    data-lanes = <1>;
                    link-frequencies = /bits/ 64 <600000000>;
                };
            };
        };
    };
...
```
